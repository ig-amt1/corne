#include "keys_br_abnt2.h"
#include "helper.h"
#include "accents.dtsi"
#include <behaviors.dtsi>
#include <dt-bindings/zmk/bt.h>
#include <dt-bindings/zmk/keys.h>
#include <dt-bindings/zmk/outputs.h>
#include <dt-bindings/zmk/pointing.h>

#define BASE 0
#define NUME 1
#define SYMB 2
#define FUNC 3
#define NAVI 4
#define ACCE 5
#define NUMB 6
#define MOUS 7

AC_KEY(A_acute, BR_A, BR_ACUT)
AC_KEY(A_grave, BR_A, BR_GRAVE)
AC_KEY(A_tilde, BR_A, BR_TILDE)
AC_KEY(A_circ,  BR_A, BR_CIRC)
AC_KEY(E_acute, BR_E, BR_ACUT)
AC_KEY(E_circ,  BR_E, BR_CIRC)
AC_KEY(I_acute, BR_I, BR_ACUT)
AC_KEY(O_acute, BR_O, BR_ACUT)
AC_KEY(O_tilde, BR_O, BR_TILDE)
AC_KEY(O_circ,  BR_O, BR_CIRC)
AC_KEY(U_acute, BR_U, BR_ACUT)
UNDEAD_KEY(tilde, BR_TILDE)
UNDEAD_KEY(caret, BR_CIRC)
UNDEAD_KEY(grave, BR_GRAVE)

// Behavior configuration

&mt {
    tapping-term-ms = <200>;
    quick_tap_ms = <0>;
    flavor = "tap-preferred";
};

&lt {
    tapping-term-ms = <200>;
    quick_tap_ms = <0>;
    flavor = "tap-preferred";
};

&sk {
    release-after-ms = <500>;
    quick-release;
};

/ {
    behaviors {
        hm: homerow_mods {
            compatible = "zmk,behavior-hold-tap";
            label = "HOMEROW_MODS";
            #binding-cells = <2>;
            tapping-term-ms = <TAPPING_TERM>;
            flavor = "balanced";
            bindings = <&kp>, <&kp>;
        };

        tab_esc: tab_esc {
            compatible = "zmk,behavior-tap-dance";
            label = "TAB_ESC";
            #binding-cells = <0>;
            tapping-term-ms = <200>;
            bindings = <&kp TAB>, <&kp ESC>;
        };

        hml: hml {
            compatible = "zmk,behavior-hold-tap";
            label = "HML";
            bindings = <&kp>, <&kp>;

            #binding-cells = <2>;
            tapping-term-ms = <280>;
            quick-tap-ms = <175>;
            flavor = "balanced";
            hold-trigger-on-release;
            hold-trigger-key-positions = <6 7 8 9 10 11 18 19 20 21 22 23 30 31 32 33 34 35 38 39 40 41 37 36>;
            require-prior-idle-ms = <150>;
        };

        hmr: hmr {
            compatible = "zmk,behavior-hold-tap";
            label = "HMR";
            bindings = <&kp>, <&kp>;

            #binding-cells = <2>;
            tapping-term-ms = <280>;
            quick-tap-ms = <175>;
            hold-trigger-on-release;
            hold-trigger-key-positions = <0 1 2 3 4 5 12 13 14 15 16 17 24 25 26 27 28 29 36 37 38 39 40 41>;
            flavor = "balanced";
            require-prior-idle-ms = <150>;
        };

        lrt: lrt {
            compatible = "zmk,behavior-hold-tap";
            label = "LRT";
            bindings = <&mo>, <&kp>;

            #binding-cells = <2>;
            tapping-term-ms = <150>;
            flavor = "tap-preferred";
        };

        sticky: sticky {
            compatible = "zmk,behavior-sticky-key";
            label = "STICKY";
            bindings = <&none>;
            #binding-cells = <1>;
            release-after-ms = <0>;
        };

        toggle_behavior: toggle_behavior {
            compatible = "zmk,behavior-toggle-layer";
            label = "TOGGLE_BEHAVIOR";
            #binding-cells = <1>;
        };

        togkey_behavior: togkey_behavior {
            compatible = "zmk,behavior-key-toggle";
            label = "TOGKEY_BEHAVIOR";
            #binding-cells = <1>;
        };

        tap_behavior: tap_behavior {
            compatible = "zmk,behavior-tap-dance";
            label = "TAP_BEHAVIOR";
            #binding-cells = <0>;
            bindings = <&none>;
        };
    };

    combos {
        compatible = "zmk,combos";

        asp {
            timeout-ms = <50>;
            key-positions = <1 2>;
            bindings = <&kp BR_DQT>;
            layers = <0>;
        };

        fn {
            timeout-ms = <50>;
            bindings = <&mo 4>;
            key-positions = <16 15>;
            layers = <0>;
        };

        close {
            timeout-ms = <50>;
            bindings = <&close>;
            key-positions = <1 2 3 4>;
            layers = <0>;
        };

        prtsc_combo {
            timeout-ms = <50>;
            bindings = <&kp PRINTSCREEN>;
            key-positions = <6 5>;
            layers = <0>;
        };

        caps {
            timeout-ms = <50>;
            bindings = <&caps_word>;
            key-positions = <25 26 27 28>;
            layers = <0>;
        };

        quest {
            bindings = <&kp BR_QMARK>;
            key-positions = <33 32 31>;
            layers = <0>;
        };

        lock {
            bindings = <&lock>;
            key-positions = <7 8 9>;
            layers = <5>;
        };

        copy {
            bindings = <&copy>;
            key-positions = <26 27>;
            layers = <0>;
        };

        paste {
            bindings = <&paste>;
            key-positions = <27 28>;
            layers = <0>;
        };

        circ {
            bindings = <&kp BR_CIRC>;
            key-positions = <7 8>;
            layers = <0>;
        };

        agud {
            bindings = <&kp BR_ACUT>;
            key-positions = <9 8>;
            layers = <0>;
        };

        til {
            bindings = <&kp BR_TILDE>;
            key-positions = <1 0>;
            layers = <0>;
        };

        grave {
            bindings = <&kp BR_GRAVE>;
            key-positions = <32 31 30>;
            layers = <0>;
        };

        rgui {
            bindings = <&kp LWIN>;
            key-positions = <35 34>;
            layers = <0>;
        };

        lgui {
            bindings = <&kp LWIN>;
            key-positions = <24 25>;
            layers = <0>;
        };

        f1 {
            bindings = <&kp F1>;
            key-positions = <13 25>;
            layers = <0>;
        };

        f2 {
            bindings = <&kp F2>;
            key-positions = <14 26>;
            layers = <0>;
        };

        f3 {
            bindings = <&kp F3>;
            key-positions = <15 27>;
            layers = <0>;
        };

        f4 {
            bindings = <&kp F4>;
            key-positions = <16 28>;
            layers = <0>;
        };

        f5 {
            bindings = <&kp F5>;
            key-positions = <17 29>;
        };

        aspas {
            bindings = <&aspas>;
            key-positions = <10 9>;
            layers = <0>;
        };
    };

    macros {
        close: close {
            compatible = "zmk,behavior-macro";
            label = "new_macro";
            #binding-cells = <0>;
            bindings =
                <&macro_press>,
                <&kp LALT>,
                <&macro_tap>,
                <&kp F4>,
                <&macro_release>,
                <&kp LALT>;
        };

        cao: cao {
            compatible = "zmk,behavior-macro";
            label = "CAO";
            #binding-cells = <0>;
            bindings =
                <&macro_tap>,
                <&kp BR_CCED>,
                <&macro_tap_time 20>,
                <&A_tilde>;
        };

        guilt: guilt {
            compatible = "zmk,behavior-macro";
            label = "GUILT";
            #binding-cells = <0>;
            bindings =
                <&macro_press>,
                <&kp LEFT_GUI>,
                <&macro_tap>,
                <&kp LEFT>,
                <&macro_release>,
                <&kp LEFT_GUI>;
        };

        guirt: guirt {
            compatible = "zmk,behavior-macro";
            label = "GUIRT";
            #binding-cells = <0>;
            bindings =
                <&macro_press>,
                <&kp LEFT_GUI>,
                <&macro_tap>,
                <&kp RIGHT>,
                <&macro_release>,
                <&kp LEFT_WIN>;
        };

        lock: lock {
            compatible = "zmk,behavior-macro";
            label = "LOCK";
            #binding-cells = <0>;
            bindings =
                <&macro_press>,
                <&kp LEFT_GUI>,
                <&macro_tap>,
                <&kp L>,
                <&macro_release>,
                <&kp LEFT_GUI>;
        };

        gui_up: gui_up {
            compatible = "zmk,behavior-macro";
            #binding-cells = <0>;
            bindings =
                <&macro_press>,
                <&kp LEFT_GUI>,
                <&macro_tap>,
                <&kp UP_ARROW>,
                <&macro_release>,
                <&kp LEFT_GUI>;

            label = "GUI_UP";
        };

        copy: copy {
            compatible = "zmk,behavior-macro";
            #binding-cells = <0>;
            bindings =
                <&macro_press>,
                <&kp LEFT_CONTROL>,
                <&macro_tap>,
                <&kp C>,
                <&macro_release>,
                <&kp LEFT_CONTROL>;

            label = "COPY";
        };

        paste: paste {
            compatible = "zmk,behavior-macro";
            #binding-cells = <0>;
            bindings =
                <&macro_press>,
                <&kp LEFT_CONTROL>,
                <&macro_tap>,
                <&kp V>,
                <&macro_release>,
                <&kp LEFT_CONTROL>;

            label = "PASTE";
        };

        tab: tab {
            compatible = "zmk,behavior-macro";
            #binding-cells = <0>;
            bindings =
                <&macro_press>,
                <&kp LEFT_ALT>,
                <&macro_tap>,
                <&kp TAB>,
                <&macro_release>,
                <&kp LALT>;

            label = "TAB";
        };

        new_tab: new_tab {
            compatible = "zmk,behavior-macro";
            #binding-cells = <0>;
            bindings =
                <&macro_press>,
                <&kp LEFT_ALT>,
                <&macro_tap>,
                <&kp ESCAPE>,
                <&macro_release>,
                <&kp LEFT_ALT>;

            label = "NEW_TAB";
        };

        tabup: tabup {
            compatible = "zmk,behavior-macro";
            #binding-cells = <0>;
            bindings =
                <&macro_press>,
                <&kp LCTRL>,
                <&macro_tap>,
                <&kp TAB>,
                <&macro_release>,
                <&kp LCTRL>;

            label = "TABUP";
        };

        tabdwn: tabdwn {
            compatible = "zmk,behavior-macro";
            #binding-cells = <0>;
            bindings =
                <&macro_press>,
                <&kp LCTRL &kp LSHFT>,
                <&macro_tap>,
                <&kp TAB>,
                <&macro_release>,
                <&kp LCTRL &kp LSHFT>;

            label = "TABDWN";
        };

        teste: teste {
            compatible = "zmk,behavior-macro";
            #binding-cells = <0>;
            bindings =
                <&macro_press>,
                <&kp LEFT_GUI>,
                <&macro_tap>,
                <&kp DOT>,
                <&macro_release>,
                <&kp LEFT_GUI>;

            label = "TESTE";
        };

        print: print {
            compatible = "zmk,behavior-macro";
            #binding-cells = <0>;
            bindings =
                <&macro_press>,
                <&kp LEFT_GUI &kp LEFT_SHIFT>,
                <&macro_tap>,
                <&kp S>,
                <&macro_release>,
                <&kp LEFT_GUI &kp LSHIFT>;

            label = "PRINT";
        };

        undo: undo {
            compatible = "zmk,behavior-macro";
            #binding-cells = <0>;
            bindings =
                <&macro_press>,
                <&kp LEFT_CONTROL>,
                <&macro_tap>,
                <&kp Z>,
                <&macro_release>,
                <&kp LEFT_CONTROL>;

            label = "UNDO";
        };

        aspas: aspas {
            compatible = "zmk,behavior-macro";
            #binding-cells = <0>;
            bindings = <&kp DQT &kp SPACE &kp DQT>;
            label = "ASPAS";
        };
    };

    keymap {
        compatible = "zmk,keymap";

        base_layer {
            bindings = <
&kp ESCAPE  &kp Q  &kp W       &kp E           &kp R        &kp T        &kp Y        &kp U         &kp I            &kp O       &kp P         &kp C_VOLUME_UP
&kp LSHFT   &kp A  &hm LALT S  &hm LSHFT D     &hm LCTRL F  &kp G        &kp H        &hm RCTRL J   &hm RSHFT K      &hm RALT L  &kp BR_SEMI   &kp C_VOLUME_DOWN
&kp LCTRL   &kp Z  &kp X       &kp C           &kp V        &kp B        &kp N        &kp M         &kp COMMA        &kp DOT     &kp BR_SLASH  &kp BR_CCED
                               &lt 3 CAPSLOCK  &lt 1 TAB    &kp SPACE    &lt 6 ENTER  &lt 2 DELETE  &lt 5 BACKSPACE
            >;
        };

        number_layer {
            bindings = <
&kp ESCAPE         &kp BR_EXCL   &kp BR_AT    &kp BR_HASH   &kp BR_DLLR  &kp BR_PRCNT    &kp PLUS      &kp N7     &kp N8        &kp N9  &kp BR_BSLH   &kp BACKSPACE
&kp RIGHT_BRACKET  &kp BR_GRAVE  &kp BR_AMPS  &kp BR_ASTRK  &kp BR_LPAR  &kp BR_RPAR     &kp MINUS     &kp N4     &kp N5        &kp N6  &kp COMMA     &kp LEFT_BRACE
&kp LEFT_BRACKET   &kp BR_UNDER  &kp BR_LBRC  &kp BR_RBRC   &kp BR_LT    &kp BR_GT       &kp BR_COLON  &kp N1     &kp N2        &kp N3  &kp BR_EQUAL  &kp RIGHT_BRACE
                                              &kp BR_ASTRK  &trans       &none           &kp COMMA     &kp BR_N0  &kp BR_EQUAL
            >;
        };

        accent_layer {
            bindings = <
&trans  &kp BR_ASTRK  &kp BR_AMPS  &kp BR_LBRC  &kp BR_RBRC  &kp BR_HASH    &kp BR_CIRC  &U_acute      &A_tilde  &O_tilde  &kp BR_CCED  &teste
&trans  &kp BR_COLON  &kp BR_AT    &kp BR_LPAR  &kp BR_RPAR  &kp BR_DQT     &kp BR_ACUT  &I_acute      &A_acute  &O_acute  &E_acute     &kp F10
&kp     &trans        &kp BR_EXCL  &kp PERCENT  &kp BR_LBKT  &kp BR_RBKT    &kp BR_PIPE  &kp BR_TILDE  &E_circ   &A_circ   &O_circ      &A_grave
                                   &kp F20      &none        &tog 2         &cao         &none         &trans
            >;
        };

        symbol_layer {
            bindings = <
&trans  &kp BR_CIRC  &kp BR_ACUT  &kp HASH  &kp CARET  &kp BR_TILDE    &kp BR_ASTRK  &kp BR_AMPS  &kp BR_LBRC  &kp BR_RBRC  &kp BR_HASH  &trans
&trans  &kp GRAVE    &kp DQT      &kp SQT   &kp EXCL   &kp TILDE       &kp BR_COLON  &kp BR_AT    &kp BR_LPAR  &kp BR_RPAR  &kp BR_DQT   &trans
&trans  &none        &none        &ac_ccdi  &none      &none           &kp BR_EXCL   &kp PERCENT  &kp BR_LBKT  &kp BR_RBKT  &kp BR_PIPE  &trans
                                  &trans    &trans     &trans          &kp ENTER     &kp BSPC     &kp DEL
            >;
        };

        function_layer {
            bindings = <
&trans  &trans  &trans  &trans  &trans  &trans    &trans  &kp F1  &kp F2   &kp F3   &kp F4   &kp C_BRI_UP
&trans  &trans  &trans  &trans  &trans  &trans    &trans  &kp F5  &kp F6   &kp F7   &kp F8   &kp C_BRI_DN
&kp A   &trans  &trans  &trans  &trans  &trans    &trans  &kp F9  &kp F10  &kp F11  &kp F12  &trans
                        &trans  &trans  &trans    &trans  &trans  &tog 4
            >;
        };

        nav_layer {
            bindings = <
&bt BT_CLR_ALL  &bt BT_CLR  &bt BT_SEL 0  &bt BT_SEL 1  &bt BT_SEL 2  &out OUT_TOG    &kp C_VOLUME_UP    &print          &kp UP_ARROW      &tabdwn     &tabup  &new_tab
&trans          &trans      &trans        &trans        &trans        &trans          &kp C_VOLUME_DOWN  &kp LEFT_ARROW  &kp DOWN          &kp RIGHT   &trans  &tab
&print          &kp HOME    &kp END       &kp PG_UP     &kp PG_DN     &undo           &kp RC(C_MUTE)     &sk C_PREVIOUS  &sk C_PLAY_PAUSE  &kp C_NEXT  &trans  &teste
                                          &caps_word    &lt 4 END     &kp LALT        &trans             &trans          &trans
            >;
        };

        mous_layer {
            bindings = <
&trans  &trans  &trans  &trans  &trans  &trans    &msc SCRL_UP    &mkp LCLK       &mmv MOVE_UP    &mkp RCLK        &trans  &kp C
&trans  &trans  &trans  &trans  &trans  &trans    &msc SCRL_DOWN  &mmv MOVE_LEFT  &mmv MOVE_DOWN  &mmv MOVE_RIGHT  &trans  &trans
&trans  &trans  &trans  &trans  &trans  &trans    &trans          &trans          &trans          &trans           &trans  &trans
                        &trans  &trans  &trans    &trans          &trans          &trans
            >;
        };
    };
};
