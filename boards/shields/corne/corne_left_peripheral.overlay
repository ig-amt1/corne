/*
 * Copyright (c) 2020 Pete Johanson
 * SPDX-License-Identifier: MIT
 */

#include "corne.dtsi"

/* Remove a referência do display do sistema de build */
/ {
    chosen {
        /delete-property/ zephyr,display;
    };
};

/* Desativa o barramento I2C para liberar os pinos 19 e 20 para as teclas */
&pro_micro_i2c {
    status = "disabled";
};

&kscan0 {
    col-gpios
        = <&pro_micro 21 GPIO_ACTIVE_HIGH>
        , <&pro_micro 20 GPIO_ACTIVE_HIGH>
        , <&pro_micro 19 GPIO_ACTIVE_HIGH>
        , <&pro_micro 18 GPIO_ACTIVE_HIGH>
        , <&pro_micro 15 GPIO_ACTIVE_HIGH>
        , <&pro_micro 14 GPIO_ACTIVE_HIGH>
        ;
};
